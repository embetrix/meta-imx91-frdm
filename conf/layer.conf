## conf/machine/imx91frdm.conf
```bitbake
#@TYPE: Machine
#@NAME: i.MX 91 LPDDR4 FRDM
#@SOC: i.MX91
#@DESCRIPTION: A Consolidated machine configuration for i.MX 91 LPDDR4 FRDM
#@MAINTAINER: Ayoub Zaki <ayoub.zaki@embetrix.com>

MACHINEOVERRIDES =. "mx91:"

require conf/machine/include/imx91-evk.inc

KERNEL_DEVICETREE_BASENAME = "imx91-11x11-frdm"

KERNEL_DEVICETREE:append:use-nxp-bsp = " \
    freescale/${KERNEL_DEVICETREE_BASENAME}-8mic.dtb \
    freescale/${KERNEL_DEVICETREE_BASENAME}-aud-hat.dtb \
    freescale/${KERNEL_DEVICETREE_BASENAME}-ld.dtb \
    freescale/${KERNEL_DEVICETREE_BASENAME}-lpuart.dtb \
    freescale/${KERNEL_DEVICETREE_BASENAME}-mt9m114.dtb \
    freescale/${KERNEL_DEVICETREE_BASENAME}-tianma-wvga-panel.dtb \
"

UBOOT_CONFIG_BASENAME = "imx91_11x11_frdm"

UBOOT_CONFIG[ecc] = "${UBOOT_CONFIG_BASENAME}_inline_ecc_defconfig"

DDR_FIRMWARE_NAME = " \
    lpddr4_dmem_1d_v202201.bin \
    lpddr4_dmem_2d_v202201.bin \
    lpddr4_imem_1d_v202201.bin \
    lpddr4_imem_2d_v202201.bin \
"
```
